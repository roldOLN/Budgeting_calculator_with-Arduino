
#include <Keypad.h>
#include <SPI.h>
#include <Wire.h>
#include <Adafruit_GFX.h>
#include <Adafruit_SSD1306.h>
#include <EEPROM.h>


#define SCREEN_WIDTH 128  // OLED display width, in pixels
#define SCREEN_HEIGHT 32  // OLED display height, in pixels

#define OLED_RESET -1        // Reset pin # (or -1 if sharing Arduino reset pin)
#define SCREEN_ADDRESS 0x3C  ///< See datasheet for Address; 0x3D for 128x64, 0x3C for 128x32
Adafruit_SSD1306 display(SCREEN_WIDTH, SCREEN_HEIGHT, &Wire, OLED_RESET);

// images in display
static const unsigned char PROGMEM image_bubdget_3_bits[] = { 0x1f, 0xff, 0xff, 0xff, 0xff, 0xff, 0xff, 0xff, 0xff, 0xff, 0xff, 0xff, 0xff,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 0x00, 0x00 };
static const unsigned char PROGMEM image_WEEKLY_2_bits[] = { 0x00, 0x00, 0x00, 0x00, 0x00, 0x00, 0x00, 0x00, 0x00, 0x00, 0x00, 0x00, 0x00,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 0x00, 0x00 };
static const unsigned char PROGMEM image_MONTHLY_bits[] = { 0x00, 0x00, 0x00, 0x00, 0x00, 0x00, 0x00, 0x00, 0x00, 0x00, 0x00, 0x00, 0x00,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 0x00, 0x00 };
static const unsigned char PROGMEM image_NO__OF_DAYS_bits[] = { 0x00, 0x00, 0x00, 0x00, 0x00, 0x00, 0x00, 0x00, 0x00, 0x00, 0x00, 0x00, 0x00,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 0x00, 0x00 };
static const unsigned char PROGMEM image_HeatLo_hvr_25x27_bits[] = { 0x1f, 0xff, 0xfc, 0x00, 0x3f, 0xff, 0xfe, 0x00, 0x7f, 0xff, 0xff, 0x00, 0xff,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 0xfc, 0x00 };
static const unsigned char PROGMEM image_Layer_4_bits[] = {0xff,0xff,0xff};
static const unsigned char PROGMEM image__422228519_1605910946902258_3444628008906271572_n_bits[] = {0x00,0x00,0x00,0x00,0x00,0x00,0x00,0x00,0x00,0x00,0x00,0x00,0x00,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0x00,0x00};


//row and col size:
const byte ROW = 5;
const byte COL = 4;

// kepad assignments:
char mgaPipindutin[ROW][COL] = {

  { 'b', 'm', '>', '<' },
  { '1', '2', '3', '+' },
  { '4', '5', '6', '-' },
  {'7','8','9','*'},
  { '0', '.', '=', '/' }

};

// how the rows and cols PIN assignments
byte rowPins[ROW] = {6,7,8,9,10};
byte colPins[COL] = {2,3,4,5};

//create an instance of the keypad object from lib.
Keypad titesKeypad = Keypad(makeKeymap(mgaPipindutin), rowPins, colPins, ROW, COL);

// init. variables
String nababasa = "";
bool mayDotNa = false;
bool meyn = true;
bool menuView = false;
bool dailybudgetView = false;
bool userDefinedDaysView = false;
int ibahinNa = 0;
String sagot = "";
String defDays = "";
int b = 0;
int m = 0;
int address = 0;
int araw = 0;
int resulta = 0;
int ilangAraw = 0;
int anongOption = 0;
float budjPerDay = 0.0000;
float finalBudget = 0.0000;
float pambabawas = 0.0000;

// custom obj for EEPROM storage and retrieval
struct MyObject {
  float BPD;
  float FB;
  int Ahhraw;
  int ilangAhhraw;
};

void meynScreenView (String inputNiShek, String budgetNiShek){
    display.drawBitmap(0, 0, image_bubdget_3_bits, 128, 32, 1);
    display.setTextColor(1);
    display.setTextSize(1);
    display.setCursor(59, 4);
    display.setTextWrap(false);
    display.print(budgetNiShek);
    display.setTextColor(1);
    display.setTextSize(2);
    display.setCursor(2, 17);
    display.setTextWrap(false);
    display.print(inputNiShek);
    display.display();
}

// receive user inputs
void pindotPindotNiShek (char kungAnongNapindot){
    switch (kungAnongNapindot){
      case '0':
        if (ibahinNa){
        ibahinNa = 0;
        nababasa = kungAnongNapindot;
        }
        else{
        nababasa += kungAnongNapindot;}
        break;
      case '1':
        if (ibahinNa){
        ibahinNa = 0;
        nababasa = kungAnongNapindot;
        }
        else{
        nababasa += kungAnongNapindot;}
        break;
      case '2':
        if (ibahinNa){
        ibahinNa = 0;
        nababasa = kungAnongNapindot;
        }
        else{
        nababasa += kungAnongNapindot;}
        break;
      case '3':
        if (ibahinNa){
        ibahinNa = 0;
        nababasa = kungAnongNapindot;
        }
        else{
        nababasa += kungAnongNapindot;}
        break;
      case '4':
        if (ibahinNa){
        ibahinNa = 0;
        nababasa = kungAnongNapindot;
        }
        else{
        nababasa += kungAnongNapindot;}
        break;
      case '5':
        if (ibahinNa){
        ibahinNa = 0;
        nababasa = kungAnongNapindot;
        }
        else{
        nababasa += kungAnongNapindot;}
        break;
      case '6':
        if (ibahinNa){
        ibahinNa = 0;
        nababasa = kungAnongNapindot;
        }
        else{
        nababasa += kungAnongNapindot;}
        break;
      case '7':
        if (ibahinNa){
        ibahinNa = 0;
        nababasa = kungAnongNapindot;
        }
        else{
        nababasa += kungAnongNapindot;}
        break;
      case '8':
        if (ibahinNa){
        ibahinNa = 0;
        nababasa = kungAnongNapindot;
        }
        else{
        nababasa += kungAnongNapindot;}
        break;
      case '9':
        if (ibahinNa){
        ibahinNa = 0;
        nababasa = kungAnongNapindot;
        }
        else{
        nababasa += kungAnongNapindot;}
        break;
      case '.':
        if (mayDotNa){
          //do nothing
        }
        else {
        if (ibahinNa){
        ibahinNa = 0;
        nababasa = kungAnongNapindot;
        }
        else{
        nababasa += kungAnongNapindot;}
        }
        mayDotNa = true;
        break;
      case '+':
        mayDotNa = false;
        if (ibahinNa){
        ibahinNa = 0;
        nababasa = kungAnongNapindot;
        }
        else{
        nababasa += kungAnongNapindot;}
        break;
      case '-':
        mayDotNa = false;
        if (ibahinNa){
        ibahinNa = 0;
        nababasa = kungAnongNapindot;
        }
        else{
        nababasa += kungAnongNapindot;}
        break;
      case '*':
        mayDotNa = false;
        if (ibahinNa){
        ibahinNa = 0;
        nababasa = kungAnongNapindot;
        }
        else{
        nababasa += kungAnongNapindot;}
        break;
      case '/':
        mayDotNa = false;
        if (ibahinNa){
        ibahinNa = 0;
        nababasa = kungAnongNapindot;
        }
        else{
        nababasa += kungAnongNapindot;}
        break;
    }
    // Serial.println(nababasa);
}

// count number of divide or multiply
int numberOfOccurence(String saStringNato){
  int n = 0;
  for (int i = 0; i<saStringNato.length();i++){
    if (saStringNato.charAt(i) == '/' || saStringNato.charAt(i) == '*'){
      n += 1;
    }
  }
  return n;
}

//catch math and syntax errors
bool mayError(String nababasa){
  if (
    nababasa.indexOf("..") > 0 || nababasa.indexOf("+/") > 0 || nababasa.indexOf("+*") > 0 || nababasa.indexOf("-/") > 0 || nababasa.indexOf("-*") > 0 || nababasa.indexOf("**") > 0 || nababasa.indexOf("*/") > 0 ||  nababasa.indexOf("*+") > 0 || nababasa.indexOf("*-") > 0 || nababasa.indexOf("//") > 0 || nababasa.indexOf("/*") > 0 || nababasa.indexOf("/+") > 0 || nababasa.indexOf("/-") > 0 || nababasa.indexOf("/+0") > -1 
  ){
    return true;
  }
  else{
    return false;
  }
}

// custom days from user
void userDefinedDays(char kungAnongNapindot){
  if (
    kungAnongNapindot == '+' || kungAnongNapindot == '-' || kungAnongNapindot == '*' || kungAnongNapindot == '/' || kungAnongNapindot == '.' || kungAnongNapindot == '='
  ){
    //do nothing
  }
  else if (
    kungAnongNapindot == '0' || kungAnongNapindot == '1' || kungAnongNapindot == '2' || kungAnongNapindot == '3' || kungAnongNapindot == '4' || kungAnongNapindot == '5' || kungAnongNapindot == '6' || kungAnongNapindot == '7' || kungAnongNapindot == '8' || kungAnongNapindot == '9'
  )
  {
    defDays += kungAnongNapindot;
  }
  else if (kungAnongNapindot == '<'){
    defDays.remove(defDays.length() - 1, 1);
  }
}

// custom day view
void customDayView(String customDays){
  display.setTextColor(1);
  display.setTextSize(1);
  display.setCursor(37, 3);
  display.setTextWrap(false);
  display.print("howManyDays:");
  display.setTextColor(1);
  display.setTextSize(2);
  display.setCursor(35, 13);
  display.setTextWrap(false);
  display.print(customDays);
  display.drawRect(6, 3, 25, 24, 1);
  display.drawBitmap(6, 7, image_Layer_4_bits, 24, 1, 1);
  display.drawLine(10, 8, 10, 26, 1);
  display.drawLine(14, 8, 14, 25, 1);
  display.drawLine(7, 11, 30, 11, 1);
  display.drawLine(18, 7, 18, 26, 1);
  display.drawLine(6, 14, 29, 14, 1);
  display.drawLine(22, 7, 22, 26, 1);
  display.drawLine(7, 17, 30, 17, 1);
  display.drawLine(26, 7, 26, 26, 1);
  display.drawLine(7, 20, 30, 20, 1);
  display.drawLine(7, 23, 30, 23, 1);
  display.fillRect(6, 3, 24, 4, 1);
  display.fillRect(15, 11, 3, 3, 1);
  display.fillRect(23, 24, 4, 2, 1);
  display.fillRect(7, 20, 4, 3, 1);
  display.display();
}

// option view
void menunuView(int option){
  switch(option){
      case 0:
        display.drawBitmap(0, 0, image_WEEKLY_2_bits, 128, 32, 1);
        display.display();
        break;
      case 1:
        display.drawBitmap(0, 0, image_MONTHLY_bits, 128, 32, 1);
        display.display();
        break;
      case 2:
        display.drawBitmap(0, 0, image_NO__OF_DAYS_bits, 128, 32, 1);
        display.display();
        break;
  }
}

// homepage view
void dailyBudgetView(String budgetKadaAraw){
  display.drawBitmap(4, 2, image_HeatLo_hvr_25x27_bits, 25, 27, 1);
  display.setTextColor(1);
  display.setTextSize(1);
  display.setCursor(34, 5);
  display.setTextWrap(false);
  display.print("DAILY BUDGET:");
  display.setTextColor(1);
  display.setTextSize(2);
  display.setCursor(32, 14);
  display.setTextWrap(false);
  display.print(budgetKadaAraw);
  display.display();
}

// calculate actual daily budget
String calculateDailyBudget(int optionType, String Sagot, char kungAnongNapindot){
  String budgetKadaAraw;
  switch (optionType){  
    case 0:
    //weekly
    budgetKadaAraw = String(Sagot.toFloat() / 7);
    ilangAraw = 7;
    break;
    case 1:
    //monthly
    budgetKadaAraw = String(Sagot.toFloat() / 30);
    ilangAraw = 30;
    break;
    case 2:
    //userdefineddays
    String shekDefinedDays = defDays;
    budgetKadaAraw = String(Sagot.toFloat() / shekDefinedDays.toFloat());
    ilangAraw = shekDefinedDays.toInt();
    break;
  }
  budjPerDay = budgetKadaAraw.toFloat();
  finalBudget = budgetKadaAraw.toFloat();
  return budgetKadaAraw;
}

// option view flagger
int menuOptions(char kungAnongNapindot){
  if (kungAnongNapindot == '<'){
    if (anongOption < 1) {
          anongOption = 3;
        }
    anongOption = (anongOption - 1) % 3;
    }
  else if (kungAnongNapindot == '>'){
    anongOption = (anongOption + 1) % 3;
  }
  return anongOption;
}

// blackboxed math parser
String calculate(String string) {
  return finalCalculation(string);
}
// blackboxed math parser
int count_chars(String string, char ch) {
  int count = 0;
  for (int i = 0; i < string.length(); i++) {
    if (string[i] == ch) { count++; }
  }
  return count;
}
// blackboxed math parser
String getNextNumber(String in, int symbolIndex) {
  bool running = true;
  String result = "";

  //FirstDigitCheck allows us to skip the first digit and always assume it's part of the number (Because of negative numbers)
  bool firstDigitCheck = true;
  for (int i = symbolIndex + 1; running; i++) {
    if (i > symbolIndex + 1) { firstDigitCheck = false; }

    if ((in[i] != '.') and (!isDigit(in[i])) and (!firstDigitCheck)) {
      running = false;
    } else {
      result += in[i];
    }

    if (i == in.length()) { running = false; }
  }
  return result;
}
// blackboxed math parser
String getPrevNumber(String in, int symbolIndex) {
  bool running = true;
  String result = "";
  for (int i = symbolIndex - 1; running; i--) {
    if ((in[i] != '.') and (!isDigit(in[i]))) {
      // Give an exception for negative numbers.
      // The if(i != 0) check allows us to also completely ignore the next digit in our checks and presume it's part of the formula.
      // This prevents bugs if the first digit is a negative number (Difficult problem to solve later on down the line)
      if (i != 0) {
        if ((in[i] == '-') and ((in[i - 1] == '/') or (in[i - 1] == '*') or (in[i - 1] == '+') or (in[i - 1] == '-'))) { result = in[i] + result; }
      } else {
        result = in[i] + result;
      }
      running = false;
    } else {
      result = in[i] + result;
    }

    if (i == 0) { running = false; }
  }

  return result;
}
// blackboxed math parser
String finalCalculation(String in) {
  // Here is where we finally do the calculation. All brackets have been taken care of, all invalid characters have been removed. Now all we need is to finally finish it up
  // We should get on something like "7+8/9*4-2+9" and be able to equate it in two steps using getPreviousNumber() to help us
  // Step 1, multiplication and division: "7+8/9*4-2+9" becomes: "7+3.55555555555556-2+9"
  // Step 2, addition and subtraction: "7+3.55555555555556-2+9" becomes "17.55555555555556" plus or minus some error due to floating point precision

  //Step 1
  for (int i = 0; i < in.length(); i++) {
    if (in[i] == '*') {
      String a = getPrevNumber(in, i);
      String b = getNextNumber(in, i);
      int index = in.indexOf(a + "*" + b);

      in = in.substring(0, index) + String(a.toFloat() * b.toFloat(), 2) + in.substring(index + a.length() + b.length() + 1, in.length());
      i = index;
    } else if (in[i] == '/') {
      String a = getPrevNumber(in, i);
      String b = getNextNumber(in, i);
      int index = in.indexOf(a + "/" + b);

      in = in.substring(0, index) + String(a.toFloat() / b.toFloat(), 2) + in.substring(index + a.length() + b.length() + 1, in.length());
      i = index;
    }
  }

  for (int i = 0; i < in.length(); i++) {
    if (in[i] == '+') {
      String a = getPrevNumber(in, i);
      String b = getNextNumber(in, i);
      int index = in.indexOf(a + "+" + b);

      in = in.substring(0, index) + String(a.toFloat() + b.toFloat(), 2) + in.substring(index + a.length() + b.length() + 1, in.length());
      i = index;
    } else if (in[i] == '-') {
      String a = getPrevNumber(in, i);
      String b = getNextNumber(in, i);
      int index = in.indexOf(a + "-" + b);

      in = in.substring(0, index) + String(a.toFloat() - b.toFloat(), 2) + in.substring(index + a.length() + b.length() + 1, in.length());
      i = index;
    }
  }

  return in;
}

// view flagger
void manageViewSwitches (char kungAnongNapindot){
  // Serial.println(resulta);
  if (kungAnongNapindot == 'b'){
    b += 1;
  }
  else if (kungAnongNapindot == 'm'){
    m += 1;
  }
  else if (kungAnongNapindot == '='){
    resulta += 1;
  }
  if (m == 1){
    // sagot = nababasa;
    meyn = false;
    menuView = true;
    dailybudgetView = false;
    userDefinedDaysView = false;
  }
  if (m == 2){
    meyn = true;
    menuView = false;
    dailybudgetView = false;
    userDefinedDaysView = false;
    m = 0;
    nababasa = sagot;
  }
  if (m == 1 & resulta == 1 & anongOption == 2){
  meyn = false;
  menuView = false;
  dailybudgetView = false;
  userDefinedDaysView = true;
  }
  if (m == 1 & resulta == 2 & anongOption == 2 ){
  meyn = false;
  menuView = false;
  dailybudgetView = true;
  userDefinedDaysView = false;
  }
  if (m == 1 & resulta == 1 & anongOption != 2){
  meyn = false;
  menuView = false;
  dailybudgetView = true;
  userDefinedDaysView = false;
  }
}

//track balance 
void trackDaysOfGastos(){
  if (budjPerDay < 0){
    araw += 1;
    budjPerDay = finalBudget + budjPerDay;
  }
}


void setup() {
  Serial.begin(9600);
  while (!Serial) {
      ; // wait for serial port to connect. Needed for native USB port only
    }
  // SSD1306_SWITCHCAPVCC = generate display voltage from 3.3V internally
  if (!display.begin(SSD1306_SWITCHCAPVCC, SCREEN_ADDRESS)) {
    Serial.println(F("SSD1306 allocation failed"));
    for (;;)
      ;  // Don't proceed, loop forever
  }
  // splash screen of tites' logo
  display.drawBitmap(0, 0, image__422228519_1605910946902258_3444628008906271572_n_bits, 128, 32, 1);
  display.setTextColor(1);
  display.setTextSize(1);
  display.setCursor(3, 3);
  display.setTextWrap(false);
  display.print("AJSE");
  display.setTextColor(1);
  display.setTextSize(1);
  display.setCursor(102, 3);
  display.setTextWrap(false);
  display.print("JKRM");
  display.setTextColor(1);
  display.setTextSize(1);
  display.setCursor(3, 22);
  display.setTextWrap(false);
  display.print("HJNC");
  display.setTextColor(1);
  display.setTextSize(1);
  display.setCursor(102, 22);
  display.setTextWrap(false);
  display.print("JAAV");
  display.display();
  delay(3000);
  display.clearDisplay();
  // variables to store in EEPROM
  MyObject customVar;
  EEPROM.get(address, customVar);
  budjPerDay = customVar.BPD;
  finalBudget = customVar.FB;
  araw = customVar.Ahhraw;
  ilangAraw = customVar.ilangAhhraw;

}

// program runner
void loop(){
  display.clearDisplay();
  char kungAnongNapindot = titesKeypad.getKey();
  manageViewSwitches(kungAnongNapindot);
  pindotPindotNiShek (kungAnongNapindot);
  trackDaysOfGastos();
  if (kungAnongNapindot == 'b'){
      pambabawas = nababasa.toFloat();
      budjPerDay -= pambabawas;}
  if (meyn){
    if (kungAnongNapindot == '<'){nababasa.remove(nababasa.length() - 1, 1);}
    if (kungAnongNapindot == '='){
      m = 0;
      ibahinNa += 1;
      // catch syntax errors
      if (numberOfOccurence(nababasa) == 1)
      {
        nababasa += "+0";
        Serial.println(nababasa);

      }
      if (mayError(nababasa)){
        nababasa = "gerdiError ";
      }
      else {
        nababasa = calculate(nababasa);
        sagot = nababasa;
        resulta = 0;
      }
    }
    if (budjPerDay){
      if (araw == ilangAraw & ilangAraw != 0){
        for (int i = 0 ; i < EEPROM.length() ; i++) {
        EEPROM.write(i, 0);
        }
        budjPerDay = 0;
        finalBudget = 0;
        araw = 0;
        ilangAraw = 0;
        nababasa = "UBOS NA!";
      }
      meynScreenView(nababasa, String(budjPerDay));
    }
    else{meynScreenView(nababasa,"0 ");
    }
  }
  else if (menuView){
    menunuView(menuOptions(kungAnongNapindot));
  }
  else if (dailybudgetView){
    dailyBudgetView(calculateDailyBudget(menuOptions(kungAnongNapindot), sagot, kungAnongNapindot));
  }
  else if (userDefinedDaysView){
    userDefinedDays(kungAnongNapindot);
    customDayView(defDays);
  }
  MyObject customVar = {
    budjPerDay,
    finalBudget,
    araw,
    ilangAraw
  };
  EEPROM.put(address, customVar);
  delay(25);
  Serial.println(budjPerDay);
}
